## components/ttp229/Kconfig.projbuild
```kconfig
menu "TTP229 Configuration"

	config SCL_GPIO
		int "SCL GPIO number"
		range 0 SOC_GPIO_OUT_RANGE_MAX
		default  4 if IDF_TARGET_ESP32
		default 17 if IDF_TARGET_ESP32S2 || IDF_TARGET_ESP32S3
		default  0 # C3 and others
		help
			GPIO number (IOxx) to SCL.
			Some GPIOs are used for other purposes (flash connections, etc.) and cannot be used to blink.

	config SDA_GPIO
		int "SDA GPIO number"
		range 0 SOC_GPIO_OUT_RANGE_MAX
		default  5 if IDF_TARGET_ESP32
		default 18 if IDF_TARGET_ESP32S2 || IDF_TARGET_ESP32S3
		default  1 # C3 and others
		help
			GPIO number (IOxx) to SDA.
			Some GPIOs are used for other purposes (flash connections, etc.) and cannot be used to blink.

endmenu
```

## main/Kconfig.projbuild
```kconfig
menu "TTP229 Configuration"

	config GPIO_RANGE_MAX
		int
		default 33 if IDF_TARGET_ESP32
		default 46 if IDF_TARGET_ESP32S2
		default 48 if IDF_TARGET_ESP32S3
		default 18 if IDF_TARGET_ESP32C2
		default 19 if IDF_TARGET_ESP32C3
		default 30 if IDF_TARGET_ESP32C6

	config SCL_GPIO
		int "SCL GPIO number"
		range 0 GPIO_RANGE_MAX
		default  4 if IDF_TARGET_ESP32
		default 17 if IDF_TARGET_ESP32S2 || IDF_TARGET_ESP32S3
		default  0 # C3 and others
		help
			GPIO number (IOxx) to SCL.
			Some GPIOs are used for other purposes (flash connections, etc.) and cannot be used to blink.

	config SDA_GPIO
		int "SDA GPIO number"
		range 0 GPIO_RANGE_MAX
		default  5 if IDF_TARGET_ESP32
		default 18 if IDF_TARGET_ESP32S2 || IDF_TARGET_ESP32S3
		default  1 # C3 and others
		help
			GPIO number (IOxx) to SDA.
			Some GPIOs are used for other purposes (flash connections, etc.) and cannot be used to blink.

endmenu
```
